## Kconfig
```kconfig
config PROSPECTOR_LAYER_ROLLER_ALL_CAPS
    bool "Convert layer names to all caps"
    default n

config PROSPECTOR_ROTATE_DISPLAY_180
    bool "Rotate the display 180 degrees"
    default n

config PROSPECTOR_USE_AMBIENT_LIGHT_SENSOR
    bool "Use ambient light sensor for auto brightness"
    default y

config PROSPECTOR_FIXED_BRIGHTNESS
    int "Fixed display brightness"
    default 50
    range 1 100
    depends on !PROSPECTOR_USE_AMBIENT_LIGHT_SENSOR

config PROSPECTOR_DISPLAY_SLEEP
    bool "Enable display sleep on USB host suspend"
    default y

config PROSPECTOR_SLEEP_DEBOUNCE_MS
    int "Host sleep detection debounce time (ms)"
    default 2000
    range 500 5000
    depends on PROSPECTOR_DISPLAY_SLEEP
```
